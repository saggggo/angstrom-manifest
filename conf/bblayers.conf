## conf/bblayers.conf
```bitbake
# LAYER_CONF_VERSION is increased each time build/conf/bblayers.conf
# changes incompatibly
LCONF_VERSION = "7"
OEROOT := "${@os.path.abspath(os.path.dirname(d.getVar('FILE', True)))}/.."

BBPATH = "${TOPDIR}"

BBFILES = ""

BASELAYERS = " \
  ${OEROOT}/layers/meta-openembedded/meta-oe \
  ${OEROOT}/layers/meta-openembedded/meta-initramfs \
  ${OEROOT}/layers/meta-openembedded/meta-multimedia \
  ${OEROOT}/layers/meta-openembedded/meta-networking \
  ${OEROOT}/layers/meta-openembedded/meta-webserver \
  ${OEROOT}/layers/meta-openembedded/meta-filesystems \
  ${OEROOT}/layers/meta-openembedded/meta-perl \
  ${OEROOT}/layers/meta-openembedded/meta-python \
  ${OEROOT}/layers/meta-qt4 \
  ${OEROOT}/layers/meta-rust \
  ${OEROOT}/layers/meta-browser \
  ${OEROOT}/layers/meta-qt5 \
  ${OEROOT}/layers/meta-ros \
  ${OEROOT}/layers/meta-photography \
  ${OEROOT}/layers/meta-maker \
"
BSPLAYERS = " \
  ${OEROOT}/layers/meta-altera \
"
# Add your overlay location to EXTRALAYERS
# Make sure to have a conf/layers.conf in there
EXTRALAYERS ?= " \
  ${OEROOT}/layers/meta-linaro/meta-linaro-toolchain \
  ${OEROOT}/layers/meta-linaro/meta-optee \
"

BBLAYERS = " \
  ${OEROOT}/layers/meta-angstrom \
  ${BASELAYERS} \
  ${BSPLAYERS} \
  ${EXTRALAYERS} \
  ${OEROOT}/layers/openembedded-core/meta \
  ${OEROOT}/layers/meta-hoshilab \
"
```

## conf/local.conf
```bitbake
# CONF_VERSION is increased each time build/conf/ changes incompatibly
CONF_VERSION = "1"

#INHERIT += "rm_work"

# Which files do we want to parse:
BBMASK = ""

# What kind of images do we want?
IMAGE_FSTYPES_append = " tar.xz"

DISTRO ?= "angstrom"
# Set DEPLOY_DIR outside of TMPDIR

DEPLOY_DIR = "${TMPDIR}/../deploy/${TCLIBC}"
# Don't generate the mirror tarball for SCM repos, the snapshot is enough
BB_GENERATE_MIRROR_TARBALLS = "0"

# Disable build time patch resolution. This would lauch a devshell
# and wait for manual intervention. We disable it.
PATCHRESOLVE = "noop"

#
# Parallelism Options
#
# These two options control how much parallelism BitBake should use. The first
# option determines how many tasks bitbake should run in parallel:
# Default to setting automatically based on cpu count
BB_NUMBER_THREADS ?= "${@oe.utils.cpu_count()}"
#
# The second option controls how many processes make should run in parallel when
# running compile tasks:
# Default to setting automatically based on cpu count
PARALLEL_MAKE ?= "-j ${@oe.utils.cpu_count()}"

#
# Shared-state files from other locations
#
# Shared state files are prebuilt cache data objects which can
# used to accelerate build time. This variable can be used to configure the system
# to search other mirror locations for these objects before it builds the data itself.
#
# This can be a filesystem directory, or a remote url such as http or ftp. These
# would contain the sstate-cache results from previous builds (possibly from other
# machines). This variable works like fetcher MIRRORS/PREMIRRORS and points to the
# cache locations to check for the shared objects.
#SSTATE_MIRRORS ?= "\
#file://.* http://someserver.tld/share/sstate/ \n \
#file://.* file:///some/local/dir/sstate/"

#SSTATE_MIRRORS ?= "\
#file://.* http://dominion.thruhere.net/angstrom/sstate-mirror/ \n "

# enable PR service on build machine itself
# its good for a case when this is the only builder
# generating the feeds
#
PRSERV_HOST = "localhost:0"

MACHINE = "cyclone5"
PREFERRED_PROVIDER_virtual/kernel = "linux-altera-ltsi-rt"
PREFERRED_VERSION_linux-altera-ltsi-rt = "4.14%"
UBOOT_CONFIG="sockit"
UBOOT_CONFIG[sockit] = "socfpga_sockit_defconfig"
KERNEL_DEVICETREE = "socfpga_cyclone5_sockit.dtb"
UBOOT_EXTLINUX= "1"
UBOOT_EXTLINUX_FDT_default = "../socfpga_cyclone5_sockit.dtb"
WKS_FILE="sockit.wks"

# optional
IMAGE_INSTALL_append += "vim"
IMAGE_INSTALL_append += "dtc python-pip"
IMAGE_INSTALL_append += "kernel-devsrc"
#IMAGE_INSTALL_append += "qtbase"
#IMAGE_INSTALL_append += "qt5-demo-extrafiles"
MACHINE_ESSENTIAL_EXTRA_RRECOMMENDS += "kernel-modules"
QTWEBKIT = ""
PACKAGECONFIG_DISTRO_pn-qtbase = "linuxfb"
```
